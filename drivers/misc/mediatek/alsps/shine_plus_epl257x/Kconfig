## drivers/misc/mediatek/hardwareinfo/Kconfig
```kconfig
config HW_INFO
	bool "HW_INFO support "
	default n
	help
	  MTK HW_INFO for mini etc.
```

## drivers/misc/mediatek/nfc-pn547/Kconfig
```kconfig
config NFC_PN547
	tristate "NXP NFC driver"
	default n
	---help---
	  Say Y here for supporting  NXP NFC PN547 /PN548.
```

## drivers/misc/mediatek/tct_hw_verno/Kconfig
```kconfig
config TCT_HW_VERNO
       bool "TCT_HW_VERNO support "	
       default n	
       help	
         TCT HARDWARD VERSION INFO.
```
